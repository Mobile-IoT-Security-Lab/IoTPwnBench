## meta-router-dashboard/conf/layer.conf
```bitbake
BBPATH .= ":${LAYERDIR}"

BBFILES += "${LAYERDIR}/recipes-*/*/*.bb \
            ${LAYERDIR}/recipes-*/*/*.bbappend"

BBFILE_COLLECTIONS += "router-dashboard"
BBFILE_PATTERN_router-dashboard = "^${LAYERDIR}/"
BBFILE_PRIORITY_router-dashboard = "8"

LAYERDEPENDS_router-dashboard = "core openembedded-layer"
LAYERSERIES_COMPAT_router-dashboard = "wrynose"
```
